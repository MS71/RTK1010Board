## esp32_fw/main/Kconfig.projbuild
```kconfig
menu "RTK1010 Node Config"

###
###
###
menu "WIFI Settings"

config WIFI_HOSTNAME
	string "Wifi Hostname"
	default "rtknode"

config WIFI_SSID
	string "Wifi SSID"
	default ""

config WIFI_PASSWORD
	string "Wifi Password"
	default ""

config WIFI_RSSI_THRESHOLD
    int "WiFi RSSI threshold to trigger roaming"
    default 0
    help
        WiFi RSSI threshold to trigger roaming value in dbm (-100 to 0). 0 denotes feature is disabled.
endmenu

###
###
###
menu "Console Settings"

choice
    prompt "Console"
    default RTK1010_NODE_CONSOLE_DEFAULT

    config RTK1010_NODE_CONSOLE_DEFAULT
        bool "Use ESP32 Default Console"

    config RTK1010_NODE_CONSOLE_USB_ACM
        bool "Use ESP32 USB ACM Console"

    config RTK1010_NODE_CONSOLE_OFF
        bool "Disable ESP32 Console"
endchoice

config RTK1010_NODE_CONSOLE_UDP
    bool "Enable UDP Console"
    
if RTK1010_NODE_CONSOLE_UDP

config RTK1010_NODE_CONSOLE_UDP_HOST
	string "UDP Console Host"
	default "devhostname"

config RTK1010_NODE_CONSOLE_UDP_PORT
	int "UDP Console Port"
	default 42007

endif
endmenu

###
###
###
choice
    prompt "Node Variant"
    default RTK1010_NODE_ROVER_NTRIP_CLIENT

    config RTK1010_NODE_ROVER_NTRIP_CLIENT
        bool "Rover NTRIP Client"

    config RTK1010_NODE_ROVER_RTCM_CLIENT
        bool "Rover RTCM TCP Client"

    config RTK1010_NODE_BASE_RTCM_SERVER
        bool "Base RTCM TCP Server"

    config RTK1010_NODE_TCP_ADAPTER
        bool "TCP Adapter/Server (RTK-1010 <=> TCP Port)"

    config RTK1010_NODE_CDC_ADAPTER
        bool "CDC Adapter (RTK-1010 <=> USB-Serial)"
endchoice


###
###
###
if RTK1010_NODE_BASE_RTCM_SERVER
menu "RTCM/TCP Server Settings"

config BASE_RTCM_SERVER_PORT
	int "RTCM/TCP Port"
	default 2101
    
endmenu

endif

###
###
###
if RTK1010_NODE_ROVER_NTRIP_CLIENT

menu "NTRIP Client Settings"

config NTRIP_HOST
	string "NTRIP Host"
	default "ntrip host"

config NTRIP_PORT
	int "NTRIP Port"
	default 2101

config NTRIP_USERNAME
	string "NTRIP Username"
	default "username"

config NTRIP_PASSWORD
	string "NTRIP Password"
	default "password"

config NTRIP_MOUNTPOINT
	string "NTRIP Mountpoint"
	default "mountpoint"

endmenu

endif

###
###
###
if RTK1010_NODE_ROVER_RTCM_CLIENT || RTK1010_NODE_ROVER_NTRIP_CLIENT

config RTK1010_NODE_PASS_TO_CDC
    bool "Pass corrected NMEA to CDC"

endif

###
###
###
if RTK1010_NODE_BASE_RTCM_SERVER

menu "RTCM Server Settings"

config RTCM_PORT
	int "RTCM Port"
	default 2101

config RTCM_SERVER_BASEXYZ
	string "Base XYZ e.g: 028442.081,4923062.884,2687870.875 or empty for auto ref position"
	default ""

endmenu

endif

###
###
###
if RTK1010_NODE_ROVER_RTCM_CLIENT

menu "RTCM Client Settings"

config RTCM_HOST
	string "RTCM Host"
	default "ntrip host"

config RTCM_PORT
	int "RTCM Port"
	default 2101

endmenu

endif

###
###
###

endmenu
```
